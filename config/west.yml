## config/west.yml
```yaml
manifest:
  remotes:
    - name: zmkfirmware
      url-base: https://github.com/zmkfirmware

    - name: podkolodnyi
      url-base: https://github.com/podkolodnyi

  projects:
    - name: zmk
      remote: podkolodnyi
      revision: main
      import: app/west.yml

  self:
    path: config
```
